## CMakeLists.txt
```
cmake_minimum_required(VERSION 3.20.0)

find_package(Zephyr REQUIRED HINTS $ENV{ZEPHYR_BASE})
project(application)

target_sources(app PRIVATE
	src/main.cpp
	src/Semaphore.cpp
)
```

## west.yml
```
manifest:
  version: 0.7

  defaults:
    remote: zephyrproject
  remotes:
    - name: zephyrproject
      url-base: https://github.com/zephyrproject-rtos
  projects:
    - name: zephyr
      repo-path: zephyr
      revision: v3.4.0-rc1
      import:
        path-prefix: deps
      path: zephyr

  self:
    path: application
```

## prj.conf
```kconfig
# Global switch, turns on/off the logging.
CONFIG_LOG=y

# Enables coloring of errors (red) and warnings (yellow).
CONFIG_LOG_BACKEND_SHOW_COLOR=n

# Default level, sets the logging level used by modules that are not setting 
# their own logging level.
# The log levels are: 0 off, 1 error, 2 warning, 3 info, 4 debug
CONFIG_LOG_DEFAULT_LEVEL=3

# Deferred mode.
CONFIG_LOG_MODE_DEFERRED=y

# Immediate (synchronous) mode.
CONFIG_LOG_MODE_IMMEDIATE=n

# Minimal footprint mode.
CONFIG_LOG_MODE_MINIMAL=n

# C++
CONFIG_CPP=y
CONFIG_CPP_MAIN=y
```

## src/main.cpp
```c
#include <zephyr/kernel.h>
#include <zephyr/logging/log.h>

#include "Semaphore.hpp"

LOG_MODULE_REGISTER(main, LOG_LEVEL_DBG);

// Time between thread messages in milliseconds.
#define SLEEPTIME 1000
#define STACKSIZE 2000

struct k_thread coop_thread;
struct k_thread main_thread;

K_THREAD_STACK_DEFINE(coop_stack, STACKSIZE);
K_THREAD_STACK_DEFINE(main_stack, STACKSIZE);

Semaphore coop_semaphore;
Semaphore main_semaphore;

void coop_thread_loop() {
    struct k_timer timer;
    k_timer_init(&timer, NULL, NULL);

    while (true) {
        // Wait for main thread to let us have a turn.
        coop_semaphore.wait();

        LOG_INF("%s", __FUNCTION__);

        // Wait a while, then let coop thread have a turn.
        k_timer_start(&timer, K_MSEC(SLEEPTIME), K_NO_WAIT);
        k_timer_status_sync(&timer);
        main_semaphore.give();
    }
}

void main_thread_loop() {
    struct k_timer timer;
    k_timer_init(&timer, NULL, NULL);

    while (true) {
        LOG_INF("%s", __FUNCTION__);

        // Wait a while, then let main thread have a turn.
        k_timer_start(&timer, K_MSEC(SLEEPTIME), K_NO_WAIT);
        k_timer_status_sync(&timer);
        coop_semaphore.give();

        // Wait for coop thread to let us have a turn.
        main_semaphore.wait();
    }
}

int main() {
    k_thread_create(&coop_thread, coop_stack, STACKSIZE,
                    (k_thread_entry_t)coop_thread_loop,
                    NULL, NULL, NULL, K_PRIO_COOP(7), 0, K_NO_WAIT);
    k_thread_create(&main_thread, main_stack, STACKSIZE,
                    (k_thread_entry_t)main_thread_loop,
                    NULL, NULL, NULL, K_PRIO_COOP(7), 0, K_NO_WAIT);
    return 0;
}
```

## src/Semaphore.cpp
```c
#include "Semaphore.hpp"

#include <zephyr/logging/log.h>

LOG_MODULE_REGISTER(Semaphore, LOG_LEVEL_DBG);

Semaphore::Semaphore() {
    LOG_DBG("Constructing Semaphore (%p)", (void *)this);
    k_sem_init(&internal_semaphore, 0, K_SEM_MAX_LIMIT);
}

Semaphore::~Semaphore() {
    LOG_DBG("Deconstructing Semaphore (%p)", (void *)this);
}

const int Semaphore::wait() {
    LOG_DBG("%s", __FUNCTION__);
    k_sem_take(&internal_semaphore, K_FOREVER);
    return 1;
}

void Semaphore::give() {
    LOG_DBG("%s", __FUNCTION__);
    k_sem_give(&internal_semaphore);
}
```

## src/Semaphore.hpp
```c
#pragma once

#include <zephyr/kernel.h>

class Semaphore {
   private:
    struct k_sem internal_semaphore;

   public:
    Semaphore();
    ~Semaphore();
    const int wait();
    void give();
};
```
